#include <Arduino.h>
#include <Wire.h>
#include <Bounce2.h>
#include <U8g2lib.h>

// SH1106 OLED DISPLAY CONSTRUCTOR
U8G2_SH1106_128X64_NONAME_F_HW_I2C u8g2(U8G2_R0, U8X8_PIN_NONE); // [full framebuffer, size = 1024 bytes]

// DEBOUNCE BUTTON CONSTRUCTOR
Bounce2::Button buttonNext = Bounce2::Button();
Bounce2::Button buttonPrevious = Bounce2::Button();
Bounce2::Button buttonSelect = Bounce2::Button();

// 'selected_item', 128x21px
const unsigned char selected_item [] PROGMEM = {
  0xF8, 0xFF, 0xFF, 0xFF, 0xFF, 0xFF, 0xFF, 0xFF, 0xFF, 0xFF, 0xFF, 0xFF,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 0x03
  };

// 'scrollbar_bg', 8x64px
const unsigned char scrollbar_bg [] PROGMEM = { 
  0x00, 0x40, 0x00, 0x40, 0x00, 0x40, 0x00, 0x40, 0x00, 0x40, 0x00, 0x40,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 0x00
};

static const unsigned char light_off[] U8X8_PROGMEM = {
  0xf8, 0xff, 0x3f, 0x00, 0x04, 0x00, 0x40, 0x00, 0x02, 0x00, 0x80, 0x00,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 0x00
  };

static const unsigned char light_on[] U8X8_PROGMEM = {
  0xf8, 0xff, 0x3f, 0x00, 0xfc, 0xff, 0x7f, 0x00, 0xfe, 0xff, 0xff, 0x00,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 0x00
  };

/* END OF BITMAP VARIABLES*/

#define nextButton 19
#define prevButton 18
#define selButton 17

const int screenWidth = 128;  // Width of the display in pixels
// const int screenHeight = 64;  // Height of the display in pixels

const int NUM_ITEMS = 8; // number of items in the list menu
const int MAX_ITEM_LENGTH = 20; // maximum characters for the item name
const char menu_items [NUM_ITEMS] [MAX_ITEM_LENGTH] = {  // array with item names
  "Living Room", 
  "Bedroom", 
  "Dining Room", 
  "Garage", 
  "Toilet", 
  "Garden",   
  "Office", 
  "Man Cave"
 };

const unsigned char* lightButton[] = {light_off, light_on}; // array of light condition whether on or off on OLED

/* Initialize all items state in here */
int itemSelected = 0;
int itemSelPrevious;
int itemSelNext;

int currentScreen = 0;

bool lightState [NUM_ITEMS] = {LOW};
/* END OF INITIALIZE ITEMS */

void setup() {
  u8g2.setColorIndex(1);  // set the color to white
  u8g2.begin(); // to start the OLED
  u8g2.setBitmapMode(1); // set to 1 for transparency mode

  // Next button
  buttonNext.attach(nextButton, INPUT_PULLUP);
  buttonNext.interval(5); 
  buttonNext.setPressedState(LOW); 

  // Previous button
  buttonPrevious.attach(prevButton, INPUT_PULLUP);
  buttonPrevious.interval(5);
  buttonPrevious.setPressedState(LOW);

  // Select button
  buttonSelect.attach(selButton, INPUT_PULLUP);
  buttonSelect.interval(5);
  buttonSelect.setPressedState(LOW);
}

void loop() {
  /* Update all the button states */
  buttonNext.update();
  buttonPrevious.update();
  buttonSelect.update();


  if (buttonSelect.pressed()) {
    if (currentScreen == 0) {
      currentScreen = 1;
    } else currentScreen = 0;
  }

  u8g2.clearBuffer();

  if (currentScreen == 0) {
    if (buttonNext.pressed()) {
      itemSelected = itemSelected + 1;
      if (itemSelected >= NUM_ITEMS) {
        itemSelected = 0; 
      }
    }

    if (buttonPrevious.pressed()) {
      itemSelected = itemSelected - 1;
      if (itemSelected < 0) {
        itemSelected = NUM_ITEMS - 1;
      }
    }

    // Draw the selected item bitmap
    u8g2.drawXBMP(0, 22, 128, 21, selected_item);
    u8g2.drawXBMP(128-8, 0, 8, 64, scrollbar_bg);

    // Draw the previous item
    u8g2.setFont(u8g_font_7x14);
    u8g2.drawStr(7, 15, menu_items[itemSelPrevious]); 

    // Draw the selected item in bold font
    u8g2.setFont(u8g_font_7x14B);    
    u8g2.drawStr(8, 15+20+2, menu_items[itemSelected]);   

    // Draw the next item
    u8g2.setFont(u8g_font_7x14);     
    u8g2.drawStr(7, 15+20+20+2+2, menu_items[itemSelNext]);  

    // Draw scrollbar handle
    u8g2.drawBox(125, 64/NUM_ITEMS * itemSelected, 3, 64/NUM_ITEMS); 
  }

  else if (currentScreen == 1) {
    // Calculate the width of the current menu item
    int itemWidth = u8g2.getStrWidth(menu_items[itemSelected]);
    
    // Calculate the x position for centering the current menu item
    int xPos = (screenWidth - itemWidth) / 2;
    
    if (buttonNext.pressed()) {
      lightState[itemSelected] = !lightState[itemSelected];
      // digitalWrite(leds[itemSelected], ledState[itemSelected]);
    }

    u8g2.setFont(u8g2_font_t0_13_tr);
    u8g2.drawStr(xPos, 12, menu_items[itemSelected]);
    u8g2.drawLine(0, 15, 127, 15);
    u8g2.drawXBMP(51, 26, 25, 27, lightButton[lightState[itemSelected]]);
  }

  // Update the previous and next item indices
  itemSelPrevious = itemSelected - 1;
  if (itemSelPrevious < 0) {
    itemSelPrevious = NUM_ITEMS - 1;  // Wrap around to the last item
  }
  
  itemSelNext = itemSelected + 1;
  if (itemSelNext >= NUM_ITEMS) {
    itemSelNext = 0;  // Wrap around to the first item
  }
  u8g2.sendBuffer();
}