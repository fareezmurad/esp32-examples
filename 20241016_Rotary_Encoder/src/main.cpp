#include <Arduino.h>
#include <Wire.h>
#include <U8g2lib.h>
#include <ESP32Encoder.h> // https://github.com/madhephaestus/ESP32Encoder.git 
 
#define CLK 26 // CLK ENCODER 
#define DT 27 // DT ENCODER 

U8G2_SH1106_128X64_NONAME_F_HW_I2C u8g2(U8G2_R0, U8X8_PIN_NONE); // OLED Consturctor
 
ESP32Encoder encoder;


static const unsigned char light_off[] U8X8_PROGMEM = {0xf8,0xff,0x3f,0x00,0x04,0x00,0x40,0x00,0x02,0x00,0x80,0x00,0x01,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0x3f,0x00};

static const unsigned char light_on[] U8X8_PROGMEM = {0xf8,0xff,0x3f,0x00,0xfc,0xff,0x7f,0x00,0xfe,0xff,0xff,0x00,0xff,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0x3f,0x00};

const unsigned char* lightButton1[] = {light_off, light_on};
const unsigned char* lightButton2[] = {light_off, light_on};
const unsigned char* lightButton3[] = {light_off, light_on};

const unsigned char** lightState[] = {
  lightButton1,
  lightButton2,
  lightButton3
};

int ledState[] = {0, 0, 0};

int ledPin[3] = {
  25, 33, 32
};

const int indexSize = sizeof(ledPin) / sizeof(ledPin[0]);
int currentIndex = 0;

int currentEncoderPos = 0;
int prevEncoderPos;

int initLedState = -1;
int progressBar = 0;
 
void setup () { 
  u8g2.begin();
  encoder.attachHalfQuad ( DT, CLK );
  encoder.setCount ( 0 );
  Serial.begin ( 115200 );

  for (int i = 0; i < 3; i++) {
    pinMode(ledPin[i], OUTPUT);
    digitalWrite(ledPin[i], LOW);
  }
}
 
void loop () {
  u8g2.clearBuffer();
  u8g2.setFontMode(1);
  u8g2.setBitmapMode(1);
  u8g2.drawXBMP(16, 18, 25, 27, lightState[0][ledState[0]]);
  u8g2.drawXBMP(51, 18, 25, 27, lightState[1][ledState[1]]);
  u8g2.drawXBMP(86, 18, 25, 27, lightState[2][ledState[2]]);

  int64_t currentEncoderPos = encoder.getCount();

  if (currentEncoderPos > prevEncoderPos) {
    ledState[initLedState] = 1;
    digitalWrite(ledPin[initLedState], HIGH);
    lightState[initLedState][ledState[initLedState]];
    initLedState++;
    if (initLedState > 2) initLedState = 2;
  } else if (prevEncoderPos > currentEncoderPos) {
    ledState[initLedState] = 0;
    digitalWrite(ledPin[initLedState], LOW);
    lightState[initLedState][ledState[initLedState]];
    initLedState--;
    if (initLedState < -1) initLedState = -1;
  }
  u8g2.sendBuffer();
  prevEncoderPos = currentEncoderPos;
}