#include <Arduino.h>
#include <Wire.h>
#include <Bounce2.h>
#include <U8g2lib.h>

U8G2_SH1106_128X64_NONAME_F_HW_I2C u8g2(U8G2_R0, U8X8_PIN_NONE);
Bounce2::Button button1 = Bounce2::Button();
Bounce2::Button button2 = Bounce2::Button();
Bounce2::Button button3 = Bounce2::Button();

#define BUTTON_PIN3 19
#define LED_PIN3 32

#define BUTTON_PIN2 17
#define LED_PIN2 33

#define BUTTON_PIN1 18
#define LED_PIN1 25

static const unsigned char light_off[] U8X8_PROGMEM = {0xf8, 0xff, 0x3f, 0x00, 0x04, 0x00, 0x40, 0x00, 0x02, 0x00, 0x80, 0x00, 0x01,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 0x3f, 0x00};

static const unsigned char light_on[] U8X8_PROGMEM = {0xf8, 0xff, 0x3f, 0x00, 0xfc, 0xff, 0x7f, 0x00, 0xfe, 0xff, 0xff, 0x00, 0xff,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 0x3f, 0x00};

const unsigned char *lightButton[] = {light_off, light_on};
int lightState = 0;   // for display
bool ledState1 = LOW; // for button
bool ledState2 = LOW; // for button
bool ledState3 = LOW; // for button

void setup()
{
  u8g2.begin();

  // Button 1
  button1.attach(BUTTON_PIN1, INPUT_PULLUP);
  button1.interval(5);
  button1.setPressedState(LOW);
  pinMode(LED_PIN1, OUTPUT);
  digitalWrite(LED_PIN1, ledState1);

  // Button 2
  button2.attach(BUTTON_PIN2, INPUT_PULLUP);
  button2.interval(5);
  button2.setPressedState(LOW);
  pinMode(LED_PIN2, OUTPUT);
  digitalWrite(LED_PIN2, ledState2);

  // Button 3
  button3.attach(BUTTON_PIN3, INPUT_PULLUP);
  button3.interval(5);
  button3.setPressedState(LOW);
  pinMode(LED_PIN3, OUTPUT);
  digitalWrite(LED_PIN3, ledState3);
}

void loop()
{
  u8g2.clearBuffer();
  u8g2.setFontMode(1);
  u8g2.setBitmapMode(1);
  u8g2.drawLine(0, 15, 127, 15);
  u8g2.drawXBMP(51, 26, 25, 27, lightButton[lightState]);
  u8g2.setFont(u8g2_font_t0_13_tr);
  u8g2.drawStr(20, 12, "Bedroom Light");
  u8g2.sendBuffer();

  button1.update();
  if (button1.pressed())
  {
    ledState1 = !ledState1;
    digitalWrite(LED_PIN1, ledState1);
  }

  button2.update();
  if (button2.pressed())
  {
    ledState2 = !ledState2;
    digitalWrite(LED_PIN2, ledState2);
  }

  button3.update();
  if (button3.pressed())
  {
    lightState = !lightState;
    ledState3 = !ledState3;
    digitalWrite(LED_PIN3, ledState3);
  }
}